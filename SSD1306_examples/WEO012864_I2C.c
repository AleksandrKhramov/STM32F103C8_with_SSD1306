//=============================================================
//          WINSTAR Display Co.,Ltd
//    LCM     	   :
//    Contraller :SSD1309
//    Author     :2010/11/24
//    history     :
//==============================================================
#include	<reg52.h>
#include 	<INTRINS.H>        // KEIL FUNCTION
#include	<stdio.h>          // define I/O functions

#define        MAX_COL		128
#define        MAX_ROW		64
#define	   ADDR_MODE	2 //0:horizontal, 1:vertical, 2:page


sbit           SDA			=P1^1;
sbit           SCL			=P1^0;
sbit           LCM_CS			=P3^1;
sbit           LCM_RST		=P3^2;

sbit        STP = P2^0;
sbit        S_S = P2^1;




unsigned char code picture1[MAX_ROW/8][MAX_COL]={//LLLLL(Arial)
0x00,0x00,0x00,0x00,0x00,0x00,0xE0,0x00,
0x00,0x00,0x00,0x00,0x00,0xE0,0x00,0x00,
0x00,0x00,0x00,0x00,0xE0,0x00,0x00,0x00,
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0x04,0x04,0x04,0x04,0x00,0x00,0x00,0x00 
};

unsigned char code picture2[MAX_ROW/8][MAX_COL]={//�^��r��(Arial)
0x00,0x00,0x00,0x00,0xC0,0x20,0xC0,0x00,
0x00,0x00,0xE0,0x20,0x20,0x20,0x20,0xC0,
0x00,0x00,0x80,0x40,0x20,0x20,0x20,0x40,
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0x10,0x10,0x0C,0x03,0x00,0x00,0x00,0x00 
};

unsigned char code picture3[MAX_ROW/8][MAX_COL]={//LLLLL(Times New)
0x00,0x00,0x00,0x00,0x00,0x20,0xE0,0x20,
0x00,0x00,0x00,0x00,0x20,0xE0,0x20,0x00,
0x00,0x00,0x00,0x20,0xE0,0x20,0x00,0x00,
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0x04,0x04,0x04,0x02,0x00,0x00,0x00,0x00 
};

unsigned char code picture4[MAX_ROW/8][MAX_COL]={//�^��r��(Times New)
0x00,0x00,0x00,0x00,0x00,0x80,0x60,0x80,
0x00,0x00,0x00,0x00,0x20,0xE0,0x20,0x20,
0x20,0x20,0xC0,0x00,0x80,0x40,0x20,0x20,
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0x00,0x00,0x00,0x00,0x00,0x00,0x00,0x00 
};

unsigned char code picture5[MAX_ROW/8][MAX_COL]={
0x00,0x00,0x00,0x00,0x00,0x00,0x00,0x00,
0x00,0x00,0x00,0x00,0x00,0x00,0x00,0x00,
0x00,0x00,0x80,0xC0,0xE0,0xF0,0xF0,0xF8,
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0x00,0x00,0x00,0x00,0x00,0x00,0x00,0x00  
};
void WriteBit(unsigned char onebit);
void Write_Cmd(unsigned char cmd);
void Write_Data(unsigned char dat);
void Initial_SSD1309(void);
void Home_Addr(void);
#if (ADDR_MODE==2)
	void Set_Addr(unsigned char page,unsigned char lCol,unsigned char hCol); //For Page  Addressing Mode
#else
	void Set_PageAddr(unsigned char star,unsigned char end); //For Horizontal/Vertical Addressing Mode
	void Set_ColAddr(unsigned char star,unsigned char end);//For Horizontal/Vertical Addressing Mode
#endif


void Full_on(void);
void Show_pic(unsigned char pic[][MAX_COL]);
void delay_100us(unsigned char d);
void delay_ms(unsigned char d)	;
void delay_s(unsigned char d);
void main(void);

void WriteBit(unsigned char onebit)
{
    unsigned char i;

	for(i=0;i<=7;i++)
    {
    	SCL=0;
    	SDA=(onebit<<i)&0x80;
    	SCL=1;
    	SCL=0;

    }
 	SCL=0;
  	SDA=1;
    SCL=1;
	SCL=0;   	    		    
}
void Write_Cmd(unsigned char cmd)
{	
	SDA=1;
	SCL=1;
	SDA=0;

	WriteBit(0x78);
	WriteBit(0x00);
 	WriteBit(cmd);
	
	SDA=1;
	SCL=1;
	SDA=0;
}

void Write_Data(unsigned char dat)
{
 	SDA=1;
	SCL=1;
	SDA=0;

	WriteBit(0x78);
	WriteBit(0x40);
 	WriteBit(dat);

	SDA=0;
	SCL=1;
	SDA=1;
}


#if (ADDR_MODE==2)
void Set_Addr(unsigned char page,unsigned char lCol,unsigned char hCol)
{
	Write_Cmd(page);//Set Page Start Address
	Write_Cmd(lCol);//Set Lower Column Start Address
	Write_Cmd(hCol);//Set Higher Column Start Address
}
#else
void Set_PageAddr(unsigned char star,unsigned char end)
{
	Write_Cmd(star);
	Write_Cmd(end);
}

void Set_ColAddr(unsigned char star,unsigned char end)
{
	Write_Cmd(star);
	Write_Cmd(end);
}
#endif

void Home_Addr(void)
{
	#if (ADDR_MODE<2)
		Write_Cmd(0x22);//Set Page Address
		Set_PageAddr(0,7);
		Write_Cmd(0x21);//Set Column Address
		Set_ColAddr(0,127);
	#else
		Set_Addr(0xb0,0,0x10);
	#endif
}



void Show_pic(unsigned char pic[][MAX_COL])
{
	unsigned char i=0,j=0;

	Home_Addr();
	for (i = 0;i<MAX_ROW/8;i++)
	{
		#if (ADDR_MODE==2)
			Set_Addr(0xb0+i,0,0x10);
		#endif
		for (j = 0;j<MAX_COL;j++)
			Write_Data(pic[i][j]);
	}
	delay_s(1);
}

void Full_on(void)
{
	unsigned char  i=0,j=0;

	Home_Addr();
	for (i = 0;i<MAX_ROW/8;i++)
	{
		#if (ADDR_MODE==2)
			Set_Addr(0xb0+i,0,0x10);
		#endif
		for (j = 0;j<MAX_COL;j++)
			Write_Data(0xff);
	}
	delay_s(1);
}

//===================================
// stp_sc();
//==================================
void stp_sc(){
	while(S_S==1){
		if(S_S==0){
			break;
		}
		if(STP==1){
			break;
		}
	}
}

void delay_100us(unsigned char d)		//12MHz_us
{
	unsigned char  i=0,j=0;

	for(j=0;j<d;j++)
	{
		for(i=0;i<100;i++)
						{}
	}
}

void delay_ms(unsigned char d)		//12MHz_us
{
	unsigned char j=0;
	
	for(j=0;j<d;j++)
	{
		delay_100us(10);
	}
}

void delay_s(unsigned char d)		//12MHz_us
{
	unsigned char x=0,y=0,j=0;

	for(j=0;j<d;j++)
	{
		for(x=0;x<100;x++)
	    	{
	     		for(y=0;y<10;y++)
	      		{
				delay_ms(1);
	     		}
	    	}
	}
}

void Initial_SSD1309(void)
{

	LCM_CS=0;
	Write_Cmd(0xae);//Set Display ON/OFF =>0xae:Display off
	
	Write_Cmd(0x20);//Set Memory Addressing Mode
	Write_Cmd(ADDR_MODE);
	Home_Addr();
	
	Write_Cmd(0x81);//Set contrast Control for BANK0
	Write_Cmd(0x80);
	
	Write_Cmd(0x40);//Set Display Start Line
	Write_Cmd(0xa0);//Set Segment Re-map =>0xa0:column addr. 0 is mapped to SEG0
	Write_Cmd(0xa4);//Entire Display On =>0xa4:resume to RAM content display
	Write_Cmd(0xa6);//Set Normal/Inverse Display =>0xa6:Normal,0xa7:inverse 
	
	Write_Cmd(0xa8);//Set Multiplex Ratio
	Write_Cmd(0x3f);//63

	Write_Cmd(0xad);//Master Configuration
	Write_Cmd(0x8e);

	Write_Cmd(0xc8);//Set COM Output Scan Direction =>0xc0:scan from COM0 to COM63, 0xc8:scan from COM63 to COM0

	Write_Cmd(0xd3);//Set Display Offset
	Write_Cmd(0x00);

	Write_Cmd(0xd5);//Set Display Clock Divid Ratio/Oscillator Frequency
	Write_Cmd(0x00);

	Write_Cmd(0xd8);//Set Area Color Mode ON/OFF & Low Power Display Mode
	Write_Cmd(0x05);//0x05:monochrome mode and low power display mode

	Write_Cmd(0xd9);//Set Pre-charge Period
	Write_Cmd(0xf1);

	Write_Cmd(0xda);//Set COM Pins Hardware Configuration
	Write_Cmd(0x12);

	Write_Cmd(0xdb);//Set Vcomh Deselect Level
	Write_Cmd(0x40);

	Write_Cmd(0x2e);//deactivate scroll
	
	Write_Cmd(0xaf);//Set Display ON/OFF =>0xaf:Display on
}

void main(void)
{
	Initial_SSD1309();
	
	while(1)
	{
		
		Full_on();
		delay_ms(10);
		stp_sc();

		Show_pic(picture1);
		delay_ms(10);
		stp_sc();

		Show_pic(picture2);
		delay_ms(10);
		stp_sc(); 

		Show_pic(picture5);
		delay_ms(10);
		stp_sc();

		Show_pic(picture3);
		delay_ms(10);
		stp_sc();

		Show_pic(picture4);
		delay_ms(10);
		stp_sc();
				   
	}
}

