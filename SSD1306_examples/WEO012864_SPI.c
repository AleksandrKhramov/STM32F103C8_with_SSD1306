//=============================================================
//          WINSTAR Display Co.,Ltd
//    LCM     	   :
//    IC          :
//    Contraller :SSD1309
//    Author     :2010/11/24
//    history     :
//==============================================================
#include	<reg52.h>
#include 	<INTRINS.H>        // KEIL FUNCTION
#include	<stdio.h>          // define I/O functions

#define    MAX_COL		128
#define    MAX_ROW		64
#define	   ADDR_MODE	2 //0:horizontal, 1:vertical, 2:page

sbit  SCL=P1^0;
sbit  DIO=P1^1;	 //data bus

sbit  STP=P2^0;
sbit  SS=P2^1;

sbit  LCM_CD =  P3^0;
sbit  LCM_CS = P3^1;
sbit  LCM_RST = P3^2;


//--------------------------------------------------
unsigned char code pic[8][MAX_COL]={
0x10,0x10,0x00,0x00,0x03,0x00,0x40,0x80,
0x40,0x8F,0x40,0x80,0x40,0x80,0x43,0x80,
0x40,0x80,0x40,0x8F,0x40,0x80,0x40,0x80,
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0x55,0xAA,0x55,0xAA,0x55,0xAA,0x55,0xAA 
};

unsigned char code pic1[8][MAX_COL]={
0xFF,0xFF,0xFF,0xFF,0xFF,0xFF,0xFF,0xFF,
0x00,0x00,0x00,0x00,0x00,0x00,0x00,0x00,
0xFF,0xFF,0xFF,0xFF,0xFF,0xFF,0xFF,0xFF,
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0xFF,0xFF,0xFF,0xFF,0xFF,0xFF,0xFF,0xFF 
};
	
unsigned char code pic2[8][MAX_COL]={
0x00,0x00,0x00,0x00,0x00,0x00,0x00,0x00,
0xFF,0xFF,0xFF,0xFF,0xFF,0xFF,0xFF,0xFF,
0x00,0x00,0x00,0x00,0x00,0x00,0x00,0x00,
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0x00,0x00,0x00,0x00,0x00,0x00,0x00,0x00  
};

unsigned char code pic3[8][MAX_COL]={
0x55,0xAA,0x55,0xAA,0x55,0xAA,0x55,0xAA,
0x55,0xAA,0x55,0xAA,0x55,0xAA,0x55,0xAA,
0x55,0xAA,0x55,0xAA,0x55,0xAA,0x55,0xAA,
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0x55,0xAA,0x55,0xAA,0x55,0xAA,0x55,0xAA 
};

unsigned char code pic4[8][MAX_COL]={
0xFF,0x01,0x01,0x01,0x01,0x01,0x01,0x81,
0x71,0x09,0x71,0x81,0x01,0x01,0x01,0xF9,
0x89,0x89,0x89,0x89,0x89,0x71,0x01,0x01,
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0x80,0x80,0x80,0x80,0x80,0x80,0x80,0xFF 
};


void STP_SS(void);
void Write_Cmd(unsigned char cmd);
void Write_Data(unsigned char dat);		   
void Initial_SSD1309(void);
void Home_Addr(void);
#if (ADDR_MODE==2)
	void Set_Addr(unsigned char page,unsigned char lCol,unsigned char hCol); //For Page  Addressing Mode
#else
	void Set_PageAddr(unsigned char star,unsigned char end); //For Horizontal/Vertical Addressing Mode
	void Set_ColAddr(unsigned char star,unsigned char end);//For Horizontal/Vertical Addressing Mode
#endif
void Full_on(void);
void V_show(void);
void H_show(void);	
void Show_pic(unsigned char pic[][MAX_COL]);
void delay_ms(unsigned char d)	;
void main(void);

 
void STP_SS()		//For winstar test board
{	 	 
	if(SS == 1)
		do
		{
		 if(STP==1) break ; 
		}
		while(STP == 0);
	 
}

//-------------------------------------------------
void Write_Cmd(unsigned char cmd)
{
    unsigned char bMask;

	LCM_CS = 0;
	LCM_CD = 0;
	for (bMask = 0x80; bMask; bMask >>= 1)
           {
            DIO = cmd & bMask;
            SCL = 0;	
	        SCL = 1;
	   }           
	LCM_CS = 1;
	_nop_();
}

void Write_Data(unsigned char dat)
{
	unsigned char bMask;

	LCM_CS = 0;
	LCM_CD = 1;
	for (bMask = 0x80; bMask; bMask >>= 1)
           {
            DIO = dat & bMask;
            SCL = 0;	
	        SCL = 1;
	   }           
	LCM_CS = 1;
	_nop_();
}


#if (ADDR_MODE==2)
void Set_Addr(unsigned char page,unsigned char lCol,unsigned char hCol)
{
	Write_Cmd(page);//Set Page Start Address
	Write_Cmd(lCol);//Set Lower Column Start Address
	Write_Cmd(hCol);//Set Higher Column Start Address
}
#else
void Set_PageAddr(unsigned char star,unsigned char end)
{
	Write_Cmd(star);
	Write_Cmd(end);
}

void Set_ColAddr(unsigned char star,unsigned char end)
{
	Write_Cmd(star);
	Write_Cmd(end);
}
#endif

void Home_Addr(void)
{
	#if (ADDR_MODE<2)
		Write_Cmd(0x22);//Set Page Address
		Set_PageAddr(0,7);
		Write_Cmd(0x21);//Set Column Address
		Set_ColAddr(0,127);
	#else
		Set_Addr(0xb0,0,0x10);
	#endif
}

void Full_on(void)
{
	unsigned char  i=0,j=0;

	Home_Addr();
	for (i = 0;i<MAX_ROW/8;i++)
	{
		#if (ADDR_MODE==2)
			Set_Addr(0xb0+i,0,0x10);
		#endif
		for (j = 0;j<MAX_COL;j++)
			Write_Data(0xff);
	}
	delay_ms(500);
}

void V_show(void)
{
	unsigned char  i=0,j=0;

	Home_Addr();
	#if (ADDR_MODE==1)
		for (i = 0;i<MAX_COL/2;i++)
		{
			for (j = 0;j<MAX_ROW/8;j++)
			{
				Write_Data(0xff);
			}
			for (j = 0;j<MAX_ROW/8;j++)
			{
				Write_Data(0x00);
			}
		}
	#else
		for (i = 0;i<MAX_ROW/8;i++)
		{
			#if (ADDR_MODE==2)
				Set_Addr(0xb0+i,0,0x10);
			#endif
			for (j = 0;j<MAX_COL/2;j++)
			{
				Write_Data(0xff);
				Write_Data(0x00);
			}
		}
	#endif
	delay_ms(500);
}

void H_show(void)
{
	unsigned char i=0,j=0;

	Home_Addr();
	for (i = 0;i<MAX_ROW/8;i++)
	{
		#if (ADDR_MODE==2)
			Set_Addr(0xb0+i,0,0x10);
		#endif
		for (j = 0;j<MAX_COL;j++)
			Write_Data(0x55);
	}
	delay_ms(500);
}

void Show_pic(unsigned char pic[][MAX_COL])
{
	unsigned char i=0,j=0;

	Home_Addr();
	for (i = 0;i<MAX_ROW/8;i++)
	{
		#if (ADDR_MODE==2)
			Set_Addr(0xb0+i,0,0x10);
		#endif
		for (j = 0;j<MAX_COL;j++)
			Write_Data(pic[i][j]);
	}
	delay_ms(500);
}  

void delay_100us(unsigned char d)		//12MHz_us
{
	unsigned char  i=0,j=0;

	for(j=0;j<d;j++)
	{
		for(i=0;i<100;i++)
						{}
	}
}

void delay_ms(unsigned char d)		//12MHz_us
{
	unsigned char j=0;
	
	for(j=0;j<d;j++)
	{
		delay_100us(10);
	}
}

void Initial_SSD1309(void)
{
	Write_Cmd(0xae);//Set Display ON/OFF =>0xae:Display off
	
	Write_Cmd(0x20);//Set Memory Addressing Mode
	Write_Cmd(ADDR_MODE);
	Home_Addr();
	
	Write_Cmd(0x81);//Set contrast Control for BANK0
	Write_Cmd(0x80);
	
	Write_Cmd(0x40);//Set Display Start Line
	Write_Cmd(0xa0);//Set Segment Re-map =>0xa0:column addr. 0 is mapped to SEG0
	Write_Cmd(0xa4);//Entire Display On =>0xa4:resume to RAM content display
	Write_Cmd(0xa6);//Set Normal/Inverse Display =>0xa6:Normal,0xa7:inverse 
	
	Write_Cmd(0xa8);//Set Multiplex Ratio
	Write_Cmd(0x3f);//63

	Write_Cmd(0xad);//Master Configuration
	Write_Cmd(0x8e);

	Write_Cmd(0xc8);//Set COM Output Scan Direction =>0xc0:scan from COM0 to COM63, 0xc8:scan from COM63 to COM0

	Write_Cmd(0xd3);//Set Display Offset
	Write_Cmd(0x00);

	Write_Cmd(0xd5);//Set Display Clock Divid Ratio/Oscillator Frequency
	Write_Cmd(0xf0);

	Write_Cmd(0xd8);//Set Area Color Mode ON/OFF & Low Power Display Mode
	Write_Cmd(0x05);//0x05:monochrome mode and low power display mode

	Write_Cmd(0xd9);//Set Pre-charge Period
	Write_Cmd(0xf1);

	Write_Cmd(0xda);//Set COM Pins Hardware Configuration
	Write_Cmd(0x12);

	Write_Cmd(0xdb);//Set Vcomh Deselect Level
	Write_Cmd(0x40);

	Write_Cmd(0x2e);//deactivate scroll
	
	Write_Cmd(0xaf);//Set Display ON/OFF =>0xaf:Display on

	LCM_PORT=0x04;
}



void main(void)
{
    Initial_SSD1309();   
    
	while(1)
	{
	    Full_on();	
		STP_SS(); 
		V_show();
		STP_SS();
		H_show();
		STP_SS();
  	    Show_pic(pic3);//
		STP_SS();
		Show_pic(pic1);//w_b
		STP_SS();
		Show_pic(pic2);//b_w
		STP_SS();
		Show_pic(pic);
		STP_SS();
		Show_pic(pic4);//ABC
		STP_SS();
	}
}
